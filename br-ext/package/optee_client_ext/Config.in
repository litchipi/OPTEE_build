## br-ext/package/optee_client_ext/Config.in
```kconfig
config BR2_PACKAGE_OPTEE_CLIENT_EXT
	bool "optee_client"
	help
	  http://github.org/OP-TEE/optee_client

config BR2_PACKAGE_OPTEE_CLIENT_EXT_SITE
	string "OP-TEE client path"
	default ""
	help
	  The path to the source directory of OP-TEE client

config BR2_PACKAGE_OPTEE_CLIENT_EXT_HW_RPMB
	bool "Enable real RPMB device"
	help
	  Enable real RPMB device support by disabling the RPMB emulation in
	  tee-supplicant.
```
